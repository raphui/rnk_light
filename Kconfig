## Kconfig
```kconfig
mainmenu "rnk kernel configuration"

config ARCH
    string
    option env="ARCH"

source "arch/$ARCH/Kconfig"
source kernel/Kconfig
source ldscripts/Kconfig
source mm/Kconfig
source utils/Kconfig
```
